## sdkconfig.defaults
```kconfig
CONFIG_PARTITION_TABLE_TWO_OTA=y
CONFIG_PARTITION_TABLE_CUSTOM_FILENAME="partitions.csv"
CONFIG_PARTITION_TABLE_FILENAME="partitions_two_ota.csv"
CONFIG_PARTITION_TABLE_OFFSET=0x8000
CONFIG_PARTITION_TABLE_MD5=y
CONFIG_ESP32_ENABLE_COREDUMP_TO_UART=y
CONFIG_MAIN_TASK_STACK_SIZE=4096
```
